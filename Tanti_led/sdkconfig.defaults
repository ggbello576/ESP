## Tanti_led/sdkconfig.defaults
```kconfig
CONFIG_BOOTLOADER_FLASH_XMC_SUPPORT=y
CONFIG_ESPTOOLPY_FLASHMODE_DOUT=y
CONFIG_ESPTOOLPY_FLASHMODE="dout"
CONFIG_ESPTOOLPY_FLASHFREQ_40M=y
CONFIG_ESPTOOLPY_FLASHFREQ="40m"
```
